## configs/lf1000_leappad_defconfig
```kconfig
BR2_arm=y
BR2_ARM_ENABLE_VFP=y
BR2_ARM_EABI=y
BR2_ARM_SOFT_FLOAT=y
BR2_TOOLCHAIN_EXTERNAL=y
BR2_CCACHE=y
BR2_OPTIMIZE_3=y
BR2_TARGET_GENERIC_HOSTNAME="leapster"
BR2_TARGET_GENERIC_ISSUE="Welcome to Retroleap"
BR2_ROOTFS_OVERLAY="board/leapfrog/lfx000/fsoverlay"
BR2_ROOTFS_POST_BUILD_SCRIPT="board/leapfrog/lfx000/generate_menuitems.py"
BR2_LINUX_KERNEL=y
BR2_LINUX_KERNEL_CUSTOM_GIT=y
BR2_LINUX_KERNEL_CUSTOM_REPO_URL="https://github.com/mac2612/lf1000_kernel.git"
BR2_LINUX_KERNEL_CUSTOM_REPO_VERSION="v2.6.37_rl14"
BR2_LINUX_KERNEL_DEFCONFIG="retroleap_lf1000_leappad"
BR2_PACKAGE_BUSYBOX_CONFIG_FRAGMENT_FILES="board/leapfrog/lfx000/busybox.fragment"
BR2_PACKAGE_ALSA_UTILS=y
BR2_PACKAGE_ALSA_UTILS_ALSACONF=y
BR2_PACKAGE_ALSA_UTILS_ACONNECT=y
BR2_PACKAGE_ALSA_UTILS_ALSAUCM=y
BR2_PACKAGE_ALSA_UTILS_ALSATPLG=y
BR2_PACKAGE_ALSA_UTILS_AMIXER=y
BR2_PACKAGE_ALSA_UTILS_APLAY=y
BR2_PACKAGE_ALSA_UTILS_ASEQDUMP=y
BR2_PACKAGE_ALSA_UTILS_ASEQNET=y
BR2_PACKAGE_ALSA_UTILS_BAT=y
BR2_PACKAGE_ALSA_UTILS_IECSET=y
BR2_PACKAGE_ALSA_UTILS_SPEAKER_TEST=y
BR2_PACKAGE_ATEST=y
BR2_PACKAGE_MTD=y
BR2_PACKAGE_DEJAVU=y
BR2_PACKAGE_GMENUNX=y
BR2_PACKAGE_OHBOY=y
BR2_PACKAGE_PICODRIVE=y
BR2_PACKAGE_POCKETSNES=y
BR2_PACKAGE_SNES9X4D=y
BR2_PACKAGE_RETROARCH=y
BR2_PACKAGE_LIBRETRO_POCKETSNES=y
BR2_PACKAGE_LIBRETRO_QUICKNES=y
BR2_PACKAGE_SDL=y
BR2_PACKAGE_SDL_GFX=y
BR2_PACKAGE_SDL_IMAGE=y
BR2_PACKAGE_SDL_IMAGE_GIF=y
BR2_PACKAGE_SDL_IMAGE_JPEG=y
BR2_PACKAGE_SDL_IMAGE_PNG=y
BR2_PACKAGE_SDL_MIXER=y
BR2_PACKAGE_SDL_NET=y
BR2_PACKAGE_SDL_SOUND=y
BR2_PACKAGE_SDL_TTF=y
BR2_PACKAGE_INPUT_EVENT_DAEMON=y
BR2_PACKAGE_LIBXML2=y
BR2_PACKAGE_ELFUTILS=y
BR2_PACKAGE_AVAHI=y
# BR2_PACKAGE_AVAHI_AUTOIPD is not set
BR2_PACKAGE_AVAHI_DAEMON=y
BR2_PACKAGE_DROPBEAR=y
BR2_TARGET_ROOTFS_TAR_GZIP=y
BR2_PACKAGE_HOST_UBOOT_TOOLS=y
```

## configs/lf2000_defconfig
```kconfig
BR2_arm=y
BR2_cortex_a9=y
BR2_ARM_ENABLE_VFP=y
BR2_ARM_EABI=y
BR2_TOOLCHAIN_EXTERNAL=y
BR2_CCACHE=y
BR2_TARGET_GENERIC_HOSTNAME="leapster"
BR2_TARGET_GENERIC_ISSUE="Welcome to Retroleap"
BR2_ROOTFS_OVERLAY="board/leapfrog/lfx000/fsoverlay"
BR2_ROOTFS_POST_BUILD_SCRIPT="board/leapfrog/lfx000/generate_menuitems.py"
BR2_LINUX_KERNEL=y
BR2_LINUX_KERNEL_CUSTOM_GIT=y
BR2_LINUX_KERNEL_CUSTOM_REPO_URL="https://github.com/mac2612/lf2000_kernel.git"
BR2_LINUX_KERNEL_CUSTOM_REPO_VERSION="v3.4.24_rl7"
BR2_LINUX_KERNEL_DEFCONFIG="retroleap_lf2000"
BR2_LINUX_KERNEL_UIMAGE=y
BR2_PACKAGE_BUSYBOX_CONFIG_FRAGMENT_FILES="board/leapfrog/lfx000/busybox.fragment"
BR2_PACKAGE_ALSA_UTILS=y
BR2_PACKAGE_ALSA_UTILS_ALSACONF=y
BR2_PACKAGE_ALSA_UTILS_ACONNECT=y
BR2_PACKAGE_ALSA_UTILS_ALSAUCM=y
BR2_PACKAGE_ALSA_UTILS_ALSATPLG=y
BR2_PACKAGE_ALSA_UTILS_AMIXER=y
BR2_PACKAGE_ALSA_UTILS_APLAY=y
BR2_PACKAGE_ALSA_UTILS_ASEQDUMP=y
BR2_PACKAGE_ALSA_UTILS_ASEQNET=y
BR2_PACKAGE_ALSA_UTILS_BAT=y
BR2_PACKAGE_ALSA_UTILS_IECSET=y
BR2_PACKAGE_ALSA_UTILS_SPEAKER_TEST=y
BR2_PACKAGE_ATEST=y
BR2_PACKAGE_MTD=y
BR2_PACKAGE_GMENUNX=y
BR2_PACKAGE_RETROARCH=y
BR2_PACKAGE_LIBRETRO_POCKETSNES=y
BR2_PACKAGE_LIBRETRO_CATSFC=y
BR2_PACKAGE_LIBRETRO_PICODRIVE=y
BR2_PACKAGE_LIBRETRO_FCEUMM=y
BR2_PACKAGE_LIBRETRO_IMAME=y
BR2_PACKAGE_LIBRETRO_GPSP=y
BR2_PACKAGE_LIBRETRO_QUICKNES=y
BR2_PACKAGE_LIBRETRO_ATARI800=y
BR2_PACKAGE_SDL=y
BR2_PACKAGE_SDL_GFX=y
BR2_PACKAGE_SDL_IMAGE=y
BR2_PACKAGE_SDL_IMAGE_GIF=y
BR2_PACKAGE_SDL_IMAGE_JPEG=y
BR2_PACKAGE_SDL_IMAGE_PNG=y
BR2_PACKAGE_SDL_MIXER=y
BR2_PACKAGE_SDL_NET=y
BR2_PACKAGE_SDL_SOUND=y
BR2_PACKAGE_SDL_TTF=y
BR2_PACKAGE_ESP8089=y
BR2_PACKAGE_INPUT_EVENT_DAEMON=y
BR2_PACKAGE_TSLIB=y
BR2_PACKAGE_LIBNL=y
BR2_PACKAGE_ELFUTILS=y
BR2_PACKAGE_AVAHI=y
# BR2_PACKAGE_AVAHI_AUTOIPD is not set
BR2_PACKAGE_AVAHI_DAEMON=y
BR2_PACKAGE_DROPBEAR=y
BR2_TARGET_ROOTFS_TAR_GZIP=y
```
